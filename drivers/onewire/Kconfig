## drivers/onewire/Kconfig
```kconfig
#
# Copyright (c) 2020 Martin Anschuetz
#
# SPDX-License-Identifier: Apache-2.0
#
#   One-Wire Bus Implementation
#

menuconfig ONEWIRE
    bool "Enable Software One-Wire"
    select GPIO
    

choice ONEWIRE_INTERFACE
    bool "One-Wire Interface Selection"
    default ONEWIRE_INTERFACE_SW

    config ONEWIRE_INTERFACE_SW
        bool "Software Implemented One-Wire"

    config ONEWIRE_INTERFACE_UART
        bool "One-Wire Implementation on top of UART"
        
endchoice
```

## dts/bindings/sw-one-wire/sw-one-wire.yaml
```yaml
# Copyright (c) 2021 Martin Anschuetz
# SPDX-License-Identifier: Apache-2.0

description: Software Implemented 1-Wire Bus

compatible: sw-one-wire

include:
    - name: base.yaml
      property-allowlist: [label]

properties:
  label:
    description: |
      Human readable Label as String.
      
  rd-gpios:
    type: phandle-array
    required: true

  wr-gpios:
    type: phandle-array
    required: true
```
